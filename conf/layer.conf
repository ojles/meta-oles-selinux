## conf/layer.conf
```bitbake
# We have a conf and classes directory, add to BBPATH
BBPATH .= ":${LAYERDIR}"

# We have recipes-* directories, add to BBFILES
BBFILES += "${LAYERDIR}/recipes-*/*/*.bb \
            ${LAYERDIR}/recipes-*/*/*.bbappend"

BBFILE_COLLECTIONS += "meta-oles-selinux"
BBFILE_PATTERN_meta-oles-selinux = "^${LAYERDIR}/"
BBFILE_PRIORITY_meta-oles-selinux = "10"

LAYERDEPENDS_meta-oles-selinux = "core selinux openembedded-layer"
LAYERSERIES_COMPAT_meta-oles-selinux = "dunfell"
```
